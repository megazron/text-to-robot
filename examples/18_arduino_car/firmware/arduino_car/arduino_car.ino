// arduino_car.ino: firmware for the robot "arduino_car", generated by Text to Robot from its wiring record.
//
// What it does: drives forwards and steers away from anything the ultrasonic sensor sees closer than 20 cm.
// Board:   Arduino Nano compatible board (ATmega328P, CH340, USB-C)
// FQBN:    arduino:avr:nano:cpu=atmega328
// Serial:  115200 baud. It reports what it is doing; send 's' to stop everything, 's' again to go on.
// Libraries: none beyond the Arduino core.
//
// Pin map (every line is a wire of WIRING.md that ends on the board; rewire the robot and generate again):
//   D2  output   motor_driver_2 BIN2: direction of rear_right_motor   [W17 CONTROLLER_D2]
//   D4  output   motor_driver_1 BIN1: direction of front_right_motor   [W5 CONTROLLER_D4]
//   D5  pwm      motor_driver_1 PWMA: speed of front_left_motor   [W1 CONTROLLER_D5]
//   D6  pwm      motor_driver_1 PWMB: speed of front_right_motor   [W4 CONTROLLER_D6]
//   D7  output   motor_driver_1 AIN1: direction of front_left_motor   [W2 CONTROLLER_D7]
//   D8  output   motor_driver_1 AIN2: direction of front_left_motor   [W3 CONTROLLER_D8]
//   D9  pwm      motor_driver_2 PWMA: speed of rear_left_motor   [W12 CONTROLLER_D9]
//   D10 pwm      motor_driver_2 PWMB: speed of rear_right_motor   [W15 CONTROLLER_D10]
//   D11 output   ultrasonic Trig   [W23 CONTROLLER_D11]
//   D12 input    ultrasonic Echo   [W24 CONTROLLER_D12]
//   A0  output   motor_driver_1 BIN2: direction of front_right_motor   [W6 CONTROLLER_A0]
//   A1  output   motor_driver_2 AIN1: direction of rear_left_motor   [W13 CONTROLLER_A1]
//   A2  output   motor_driver_2 AIN2: direction of rear_left_motor   [W14 CONTROLLER_A2]
//   A3  output   motor_driver_2 BIN1: direction of rear_right_motor   [W16 CONTROLLER_A3]
//
// First run: lift the wheels off the ground, open the serial monitor, then switch the robot's power on.
// A wheel that runs backwards during "forward": change its last number in MOTORS from +1 to -1 (or swap its two leads).

const unsigned long SERIAL_BAUD = 115200;
const unsigned long START_DELAY_MS = 2000;   // quiet time after power-on before anything moves
const unsigned long REPORT_EVERY_MS = 1000;  // status line on Serial

// ---------------------------------------------------------------- drive motors
struct Motor {
  const char *name;
  uint8_t pwm;       // speed input of the driver (a PWM pin)
  uint8_t in1, in2;  // direction inputs of the driver
  int8_t side;       // +1 left, -1 right, 0 unknown
  int8_t forward;    // +1: IN1 high drives the robot forwards; -1: IN2 high does (the right side is the left one mirrored)
};
const Motor MOTORS[] = {
  {"front_left_motor", 5, 7, 8, +1, +1},   // motor_driver_1 channel A
  {"front_right_motor", 6, 4, A0, -1, -1},   // motor_driver_1 channel B
  {"rear_left_motor", 9, A1, A2, +1, +1},   // motor_driver_2 channel A
  {"rear_right_motor", 10, A3, 2, -1, -1},   // motor_driver_2 channel B
};
const uint8_t MOTOR_COUNT = sizeof(MOTORS) / sizeof(MOTORS[0]);
const int PWM_MAX = 182;      // 6 V motors on a supply that reaches 8.4 V: 6 / 8.4 x 255
const int CRUISE_PWM = 146;   // 80 % of PWM_MAX
const int TURN_PWM = PWM_MAX;   // turning on the spot drags the wheels sideways: full allowed voltage

// ---------------------------------------------------------------- range sensor
const uint8_t TRIG_PIN = 11, ECHO_PIN = 12;   // ultrasonic
const unsigned int RANGE_MAX_CM = 200;   // the sensor reaches 400 cm; listening only this far keeps one ping under 12 ms
const unsigned long ECHO_TIMEOUT_US = RANGE_MAX_CM * 58UL;   // echo time / 58 = cm (datasheet)
const unsigned long PING_EVERY_MS = 60;      // the datasheet asks for 60 ms between pings
const unsigned int STOP_CM = 20;             // closer than this is an obstacle

// ---------------------------------------------------------------- driving
enum DriveState : uint8_t { DRIVE_WAIT, DRIVE_FORWARD, DRIVE_BRAKE, DRIVE_REVERSE, DRIVE_TURN };
const unsigned long BRAKE_MS = 200;
const unsigned long REVERSE_MS = 400;
const unsigned long TURN_MS = 1122;      // a quarter turn at the design's 1.40 rad/s on a hard floor; no encoders, so tune it on your floor

bool running = true;       // 's' on Serial toggles it
bool started = false;
unsigned long lastReport = 0;
DriveState driveState = DRIVE_WAIT;
unsigned long driveSince = 0;
bool turnLeft = false;
int leftPwm = 0, rightPwm = 0;
unsigned long lastPing = 0;
unsigned int distanceCm = 0;   // last reading; 0: nothing within RANGE_MAX_CM

// speed: -PWM_MAX..PWM_MAX, positive drives the robot forwards
void setMotor(const Motor &m, int speed) {
  speed = constrain(speed, -PWM_MAX, PWM_MAX);
  bool ahead = (speed > 0) == (m.forward > 0);
  digitalWrite(m.in1, speed != 0 && ahead ? HIGH : LOW);
  digitalWrite(m.in2, speed != 0 && !ahead ? HIGH : LOW);
  analogWrite(m.pwm, abs(speed));
}

void drive(int left, int right) {
  leftPwm = left;
  rightPwm = right;
  for (uint8_t i = 0; i < MOTOR_COUNT; i++) setMotor(MOTORS[i], MOTORS[i].side > 0 ? left : right);
}

// One ping: 10 us on Trig, then the length of the Echo pulse. 0 when nothing answers within RANGE_MAX_CM.
unsigned int readDistanceCm() {
  digitalWrite(TRIG_PIN, LOW);
  delayMicroseconds(2);
  digitalWrite(TRIG_PIN, HIGH);
  delayMicroseconds(10);
  digitalWrite(TRIG_PIN, LOW);
  unsigned long us = pulseIn(ECHO_PIN, HIGH, ECHO_TIMEOUT_US);
  return (unsigned int)(us / 58UL);
}

void enterDrive(DriveState s) {
  driveState = s;
  driveSince = millis();
  switch (s) {
    case DRIVE_FORWARD:
      drive(CRUISE_PWM, CRUISE_PWM);
      Serial.println(F("drive: forward"));
      break;
    case DRIVE_BRAKE:
      drive(0, 0);
      turnLeft = !turnLeft;   // turn the other way each time
      Serial.print(F("drive: obstacle at "));
      Serial.print(distanceCm);
      Serial.println(F(" cm, stop"));
      break;
    case DRIVE_REVERSE:
      drive(-CRUISE_PWM, -CRUISE_PWM);
      Serial.println(F("drive: reverse"));
      break;
    case DRIVE_TURN:
      if (turnLeft) drive(-TURN_PWM, TURN_PWM);
      else drive(TURN_PWM, -TURN_PWM);
      Serial.println(turnLeft ? F("drive: turn left") : F("drive: turn right"));
      break;
    default:
      drive(0, 0);
      break;
  }
}

// Forward until something is closer than STOP_CM; then stop, back off, turn a quarter and look again.
void updateDrive(unsigned long now) {
  if (now - lastPing >= PING_EVERY_MS) {
    lastPing = now;
    distanceCm = readDistanceCm();
  }
  bool blocked = distanceCm > 0 && distanceCm < STOP_CM;
  unsigned long in = now - driveSince;
  switch (driveState) {
    case DRIVE_WAIT: enterDrive(DRIVE_FORWARD); break;
    case DRIVE_FORWARD: if (blocked) enterDrive(DRIVE_BRAKE); break;
    case DRIVE_BRAKE: if (in >= BRAKE_MS) enterDrive(DRIVE_REVERSE); break;
    case DRIVE_REVERSE: if (in >= REVERSE_MS) enterDrive(DRIVE_TURN); break;
    case DRIVE_TURN: if (in >= TURN_MS) enterDrive(blocked ? DRIVE_TURN : DRIVE_FORWARD); break;
  }
}

// 's' on Serial: stop everything where it is, or go on.
void setRunning(bool on) {
  running = on;
  drive(0, 0);
  driveState = DRIVE_WAIT;
  Serial.println(on ? F("running") : F("stopped: send 's' to go on"));
}

void report(unsigned long now) {
  Serial.print(F("t="));
  Serial.print(now / 1000);
  Serial.print(F(" s"));
  Serial.print(F(" dist="));
  if (distanceCm) Serial.print(distanceCm);
  else Serial.print(F("clear"));
  Serial.print(F(" cm"));
  Serial.print(F(" left="));
  Serial.print(leftPwm);
  Serial.print(F(" right="));
  Serial.print(rightPwm);
  Serial.println(running ? F("") : F(" stopped"));
}

void setup() {
  Serial.begin(SERIAL_BAUD);
  for (uint8_t i = 0; i < MOTOR_COUNT; i++) {
    pinMode(MOTORS[i].in1, OUTPUT);
    pinMode(MOTORS[i].in2, OUTPUT);
    pinMode(MOTORS[i].pwm, OUTPUT);
    setMotor(MOTORS[i], 0);
  }
  pinMode(TRIG_PIN, OUTPUT);
  digitalWrite(TRIG_PIN, LOW);
  pinMode(ECHO_PIN, INPUT);
  Serial.println(F("arduino_car: arduino_car.ino"));
  Serial.println(F("4 motors, PWM limit 182/255"));
  Serial.println(F("range sensor ultrasonic: Trig D11, Echo D12"));
  Serial.println(F("send 's' to stop or go on"));
}

void loop() {
  unsigned long now = millis();
  while (Serial.available()) {
    if (Serial.read() == 's') setRunning(!running);
  }
  if (!started && now >= START_DELAY_MS) {
    started = true;
    Serial.println(F("start"));
  }
  if (started && running) {
    updateDrive(now);
  }
  if (now - lastReport >= REPORT_EVERY_MS) {
    lastReport = now;
    report(now);
  }
}
