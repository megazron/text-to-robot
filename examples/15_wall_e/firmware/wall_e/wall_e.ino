// wall_e.ino: firmware for the robot "wall_e", generated by Text to Robot from its wiring record.
//
// What it does: drives forwards and steers away from anything the ultrasonic sensor sees closer than 20 cm; runs a pose sequence, one joint at a time from home, inside the joint limits.
// Board:   Arduino Nano compatible board (ATmega328P, CH340, USB-C)
// FQBN:    arduino:avr:nano:cpu=atmega328
// Serial:  115200 baud. It reports what it is doing; send 's' to stop everything, 's' again to go on.
// Libraries: Wire, Adafruit PWM Servo Driver Library.
//
// Pin map (every line is a wire of WIRING.md that ends on the board; rewire the robot and generate again):
//   D2  output   motor_driver_2 BIN2: direction of rear_right_motor   [W17 CONTROLLER_D2]
//   D4  output   motor_driver_1 BIN1: direction of front_right_motor   [W5 CONTROLLER_D4]
//   D5  pwm      motor_driver_1 PWMA: speed of front_left_motor   [W1 CONTROLLER_D5]
//   D6  pwm      motor_driver_1 PWMB: speed of front_right_motor   [W4 CONTROLLER_D6]
//   D7  output   motor_driver_1 AIN1: direction of front_left_motor   [W2 CONTROLLER_D7]
//   D8  output   motor_driver_1 AIN2: direction of front_left_motor   [W3 CONTROLLER_D8]
//   D9  pwm      motor_driver_2 PWMA: speed of rear_left_motor   [W12 CONTROLLER_D9]
//   D10 pwm      motor_driver_2 PWMB: speed of rear_right_motor   [W15 CONTROLLER_D10]
//   D11 output   ultrasonic Trig   [W41 CONTROLLER_D11]
//   D12 input    ultrasonic Echo   [W42 CONTROLLER_D12]
//   A0  output   motor_driver_1 BIN2: direction of front_right_motor   [W6 CONTROLLER_A0]
//   A1  output   motor_driver_2 AIN1: direction of rear_left_motor   [W13 CONTROLLER_A1]
//   A2  output   motor_driver_2 AIN2: direction of rear_left_motor   [W14 CONTROLLER_A2]
//   A3  output   motor_driver_2 BIN1: direction of rear_right_motor   [W16 CONTROLLER_A3]
//   A4  i2c      I2C SDA to servo_driver   [W39 I2C_SDA]
//   A5  i2c      I2C SCL to servo_driver   [W40 I2C_SCL]
//
// Servo channels (PCA9685 outputs are wires of WIRING.md too):
//   servo_driver 0x40 channel 0  neck_pan_servo (joint neck_pan)
//   servo_driver 0x40 channel 1  neck_tilt_servo (joint neck_tilt)
//   servo_driver 0x40 channel 2  left_hand_servo (joint left_hand)
//   servo_driver 0x40 channel 3  right_hand_servo (joint right_hand)
//   servo_driver 0x40 channel 4  left_arm_servo (joint left_arm_lift)
//   servo_driver 0x40 channel 5  right_arm_servo (joint right_arm_lift)
//   servo_driver 0x40 channel 6  left_elbow_servo (joint left_elbow)
//   servo_driver 0x40 channel 7  right_elbow_servo (joint right_elbow)
//
// First run: lift the wheels off the ground and keep clear of the joints, open the serial monitor, then switch the robot's power on.
// A wheel that runs backwards during "forward": change its last number in MOTORS from +1 to -1 (or swap its two leads).
// A joint that turns the wrong way: change its dir in JOINTS from +1 to -1. Fit each horn with the servo at its centre
// (the sketch's angle 0), the joint at the zero pose of ASSEMBLY.md. Pulse ranges are the catalog's; servo batches differ,
// so trim minUs / maxUs if a joint does not reach its end angles.

#include <Wire.h>
#include <Adafruit_PWMServoDriver.h>

const unsigned long SERIAL_BAUD = 115200;
const unsigned long START_DELAY_MS = 2000;   // quiet time after power-on before anything moves
const unsigned long REPORT_EVERY_MS = 1000;  // status line on Serial

// ---------------------------------------------------------------- drive motors
struct Motor {
  const char *name;
  uint8_t pwm;       // speed input of the driver (a PWM pin)
  uint8_t in1, in2;  // direction inputs of the driver
  int8_t side;       // +1 left, -1 right, 0 unknown
  int8_t forward;    // +1: IN1 high drives the robot forwards; -1: IN2 high does (the right side is the left one mirrored)
};
const Motor MOTORS[] = {
  {"front_left_motor", 5, 7, 8, +1, +1},   // motor_driver_1 channel A
  {"front_right_motor", 6, 4, A0, -1, -1},   // motor_driver_1 channel B
  {"rear_left_motor", 9, A1, A2, +1, +1},   // motor_driver_2 channel A
  {"rear_right_motor", 10, A3, 2, -1, -1},   // motor_driver_2 channel B
};
const uint8_t MOTOR_COUNT = sizeof(MOTORS) / sizeof(MOTORS[0]);
const int PWM_MAX = 182;      // 6 V motors on a supply that reaches 8.4 V: 6 / 8.4 x 255
const int CRUISE_PWM = 146;   // 80 % of PWM_MAX
const int TURN_PWM = PWM_MAX;   // turning on the spot drags the wheels sideways: full allowed voltage

// ---------------------------------------------------------------- range sensor
const uint8_t TRIG_PIN = 11, ECHO_PIN = 12;   // ultrasonic
const unsigned int RANGE_MAX_CM = 200;   // the sensor reaches 400 cm; listening only this far keeps one ping under 12 ms
const unsigned long ECHO_TIMEOUT_US = RANGE_MAX_CM * 58UL;   // echo time / 58 = cm (datasheet)
const unsigned long PING_EVERY_MS = 60;      // the datasheet asks for 60 ms between pings
const unsigned int STOP_CM = 20;             // closer than this is an obstacle

// ---------------------------------------------------------------- driving
enum DriveState : uint8_t { DRIVE_WAIT, DRIVE_FORWARD, DRIVE_BRAKE, DRIVE_REVERSE, DRIVE_TURN };
const unsigned long BRAKE_MS = 200;
const unsigned long REVERSE_MS = 400;
const unsigned long TURN_MS = 1354;      // a quarter turn at the design's 1.16 rad/s on a hard floor; no encoders, so tune it on your floor

// ---------------------------------------------------------------- servo joints
struct Joint {
  const char *name;
  uint8_t board;          // index into PCA
  uint8_t channel;        // PCA9685 channel
  uint16_t minUs, maxUs;  // pulse at the two ends of the servo's travel (catalog)
  uint16_t travel;        // that travel in degrees; the centre of it is joint angle 0
  int8_t dir;             // +1: a longer pulse turns the joint positive
  int16_t lower, upper, home;   // joint limits and home, tenths of a degree
};
const Joint JOINTS[] = {
  {"neck_pan", 0, 0, 500, 2400, 180, +1, -802, 802, 0},   // neck_pan_servo: hobby_sg90
  {"neck_tilt", 0, 1, 500, 2400, 180, +1, -401, 401, 0},   // neck_tilt_servo: hobby_sg90
  {"left_hand", 0, 2, 500, 2400, 180, +1, -8, 343, 0},   // left_hand_servo: hobby_sg90
  {"right_hand", 0, 3, 500, 2400, 180, +1, -343, 8, 0},   // right_hand_servo: hobby_sg90
  {"left_arm_lift", 0, 4, 500, 2400, 180, +1, -572, 283, 0},   // left_arm_servo: hobby_mg90s
  {"right_arm_lift", 0, 5, 500, 2400, 180, +1, -283, 572, 0},   // right_arm_servo: hobby_mg90s
  {"left_elbow", 0, 6, 500, 2400, 180, +1, -859, 717, 0},   // left_elbow_servo: hobby_sg90
  {"right_elbow", 0, 7, 500, 2400, 180, +1, -717, 859, 0},   // right_elbow_servo: hobby_sg90
};
const uint8_t JOINT_COUNT = sizeof(JOINTS) / sizeof(JOINTS[0]);
const uint16_t SERVO_HZ = 50;            // hobby servo frame rate
const uint16_t SERVO_SPEED_DPS = 60;      // the joint that moves furthest turns at this speed, the others arrive with it
const unsigned long SERVO_STEP_MS = 20;
const unsigned long HOLD_MS = 800;       // pause at each pose

// The pose sequence, tenths of a degree per joint in the order of JOINTS: home, then one joint at a time
// up to 60 % of the way to each of its limits (less where a link would meet the table) and back home.
const int16_t POSES[][8] PROGMEM = {
  {0, 0, 0, 0, 0, 0, 0, 0},   // home
  {481, 0, 0, 0, 0, 0, 0, 0},   // neck_pan to 48.1 deg
  {-481, 0, 0, 0, 0, 0, 0, 0},   // neck_pan to -48.1 deg
  {0, 0, 0, 0, 0, 0, 0, 0},   // home
  {0, 241, 0, 0, 0, 0, 0, 0},   // neck_tilt to 24.1 deg
  {0, -241, 0, 0, 0, 0, 0, 0},   // neck_tilt to -24.1 deg
  {0, 0, 0, 0, 0, 0, 0, 0},   // home
  {0, 0, 206, 0, 0, 0, 0, 0},   // left_hand to 20.6 deg
  {0, 0, 0, 0, 0, 0, 0, 0},   // home
  {0, 0, 0, -206, 0, 0, 0, 0},   // right_hand to -20.6 deg
  {0, 0, 0, 0, 0, 0, 0, 0},   // home
  {0, 0, 0, 0, 170, 0, 0, 0},   // left_arm_lift to 17 deg
  {0, 0, 0, 0, -343, 0, 0, 0},   // left_arm_lift to -34.3 deg
  {0, 0, 0, 0, 0, 0, 0, 0},   // home
  {0, 0, 0, 0, 0, 343, 0, 0},   // right_arm_lift to 34.3 deg
  {0, 0, 0, 0, 0, -170, 0, 0},   // right_arm_lift to -17 deg
  {0, 0, 0, 0, 0, 0, 0, 0},   // home
  {0, 0, 0, 0, 0, 0, 430, 0},   // left_elbow to 43 deg
  {0, 0, 0, 0, 0, 0, -515, 0},   // left_elbow to -51.5 deg
  {0, 0, 0, 0, 0, 0, 0, 0},   // home
  {0, 0, 0, 0, 0, 0, 0, 515},   // right_elbow to 51.5 deg
  {0, 0, 0, 0, 0, 0, 0, -430},   // right_elbow to -43 deg
  {0, 0, 0, 0, 0, 0, 0, 0},   // home
};
const uint8_t POSE_COUNT = sizeof(POSES) / sizeof(POSES[0]);

const uint32_t PCA_OSC_HZ = 25000000;    // nominal PCA9685 oscillator; clone boards are a few percent off: trim it if 50 Hz measures wrong
Adafruit_PWMServoDriver PCA[] = {Adafruit_PWMServoDriver(0x40)};   // servo_driver
const uint8_t PCA_COUNT = sizeof(PCA) / sizeof(PCA[0]);
int16_t jointNow[JOINT_COUNT], jointFrom[JOINT_COUNT], jointTo[JOINT_COUNT];
uint16_t jointUs[JOINT_COUNT];
unsigned long moveStart = 0, moveMs = 0, lastServoStep = 0, arrivedAt = 0;
uint8_t pose = 0;
bool moving = false;

bool running = true;       // 's' on Serial toggles it
bool started = false;
unsigned long lastReport = 0;
DriveState driveState = DRIVE_WAIT;
unsigned long driveSince = 0;
bool turnLeft = false;
int leftPwm = 0, rightPwm = 0;
unsigned long lastPing = 0;
unsigned int distanceCm = 0;   // last reading; 0: nothing within RANGE_MAX_CM

// speed: -PWM_MAX..PWM_MAX, positive drives the robot forwards
void setMotor(const Motor &m, int speed) {
  speed = constrain(speed, -PWM_MAX, PWM_MAX);
  bool ahead = (speed > 0) == (m.forward > 0);
  digitalWrite(m.in1, speed != 0 && ahead ? HIGH : LOW);
  digitalWrite(m.in2, speed != 0 && !ahead ? HIGH : LOW);
  analogWrite(m.pwm, abs(speed));
}

void drive(int left, int right) {
  leftPwm = left;
  rightPwm = right;
  for (uint8_t i = 0; i < MOTOR_COUNT; i++) setMotor(MOTORS[i], MOTORS[i].side > 0 ? left : right);
}

// One ping: 10 us on Trig, then the length of the Echo pulse. 0 when nothing answers within RANGE_MAX_CM.
unsigned int readDistanceCm() {
  digitalWrite(TRIG_PIN, LOW);
  delayMicroseconds(2);
  digitalWrite(TRIG_PIN, HIGH);
  delayMicroseconds(10);
  digitalWrite(TRIG_PIN, LOW);
  unsigned long us = pulseIn(ECHO_PIN, HIGH, ECHO_TIMEOUT_US);
  return (unsigned int)(us / 58UL);
}

void enterDrive(DriveState s) {
  driveState = s;
  driveSince = millis();
  switch (s) {
    case DRIVE_FORWARD:
      drive(CRUISE_PWM, CRUISE_PWM);
      Serial.println(F("drive: forward"));
      break;
    case DRIVE_BRAKE:
      drive(0, 0);
      turnLeft = !turnLeft;   // turn the other way each time
      Serial.print(F("drive: obstacle at "));
      Serial.print(distanceCm);
      Serial.println(F(" cm, stop"));
      break;
    case DRIVE_REVERSE:
      drive(-CRUISE_PWM, -CRUISE_PWM);
      Serial.println(F("drive: reverse"));
      break;
    case DRIVE_TURN:
      if (turnLeft) drive(-TURN_PWM, TURN_PWM);
      else drive(TURN_PWM, -TURN_PWM);
      Serial.println(turnLeft ? F("drive: turn left") : F("drive: turn right"));
      break;
    default:
      drive(0, 0);
      break;
  }
}

// Forward until something is closer than STOP_CM; then stop, back off, turn a quarter and look again.
void updateDrive(unsigned long now) {
  if (now - lastPing >= PING_EVERY_MS) {
    lastPing = now;
    distanceCm = readDistanceCm();
  }
  bool blocked = distanceCm > 0 && distanceCm < STOP_CM;
  unsigned long in = now - driveSince;
  switch (driveState) {
    case DRIVE_WAIT: enterDrive(DRIVE_FORWARD); break;
    case DRIVE_FORWARD: if (blocked) enterDrive(DRIVE_BRAKE); break;
    case DRIVE_BRAKE: if (in >= BRAKE_MS) enterDrive(DRIVE_REVERSE); break;
    case DRIVE_REVERSE: if (in >= REVERSE_MS) enterDrive(DRIVE_TURN); break;
    case DRIVE_TURN: if (in >= TURN_MS) enterDrive(blocked ? DRIVE_TURN : DRIVE_FORWARD); break;
  }
}

void printTenths(int16_t v) {
  if (v < 0) Serial.print('-');
  Serial.print(abs(v) / 10);
  Serial.print('.');
  Serial.print(abs(v) % 10);
}

// Pulse width for a joint angle (tenths of a degree), kept inside the joint's limits and the servo's travel.
uint16_t pulseFor(const Joint &j, int16_t angle) {
  angle = constrain(angle, j.lower, j.upper);
  long mid = ((long)j.minUs + j.maxUs) / 2;
  long us = mid + (long)j.dir * angle * (long)(j.maxUs - j.minUs) / ((long)j.travel * 10);
  return (uint16_t)constrain(us, (long)j.minUs, (long)j.maxUs);
}

void writeJoint(uint8_t i, int16_t angle) {
  jointNow[i] = angle;
  uint16_t us = pulseFor(JOINTS[i], angle);
  if (us == jointUs[i]) return;
  jointUs[i] = us;
  PCA[JOINTS[i].board].setPWM(JOINTS[i].channel, 0, (uint16_t)(((uint32_t)us * 4096UL * SERVO_HZ + 500000UL) / 1000000UL));   // 12-bit count of the 20 ms frame
}

// Start a move to a pose: every joint arrives together, the one with furthest to go at SERVO_SPEED_DPS.
void startPose(uint8_t p) {
  pose = p;
  int16_t far = 0;
  for (uint8_t i = 0; i < JOINT_COUNT; i++) {
    jointFrom[i] = jointNow[i];
    jointTo[i] = constrain((int16_t)pgm_read_word(&POSES[p][i]), JOINTS[i].lower, JOINTS[i].upper);
    far = max(far, (int16_t)abs(jointTo[i] - jointFrom[i]));
  }
  moveStart = millis();
  moveMs = (unsigned long)far * 100UL / SERVO_SPEED_DPS;
  moving = true;
  Serial.print(F("pose "));
  Serial.print(p + 1);
  Serial.print('/');
  Serial.print(POSE_COUNT);
  Serial.print(':');
  for (uint8_t i = 0; i < JOINT_COUNT; i++) {
    Serial.print(' ');
    Serial.print(JOINTS[i].name);
    Serial.print('=');
    printTenths(jointTo[i]);
  }
  Serial.println(F(" deg"));
}

void updateJoints(unsigned long now) {
  if (now - lastServoStep < SERVO_STEP_MS) return;
  lastServoStep = now;
  if (!moving) {
    if (now - arrivedAt >= HOLD_MS && POSE_COUNT > 1) startPose((pose + 1) % POSE_COUNT);
    return;
  }
  unsigned long t = now - moveStart;
  if (t >= moveMs) {
    for (uint8_t i = 0; i < JOINT_COUNT; i++) writeJoint(i, jointTo[i]);
    moving = false;
    arrivedAt = now;
    return;
  }
  for (uint8_t i = 0; i < JOINT_COUNT; i++) writeJoint(i, jointFrom[i] + (int16_t)((long)(jointTo[i] - jointFrom[i]) * (long)t / (long)moveMs));
}

// 's' on Serial: stop everything where it is, or go on.
void setRunning(bool on) {
  running = on;
  drive(0, 0);
  driveState = DRIVE_WAIT;
  if (on && moving) startPose(pose);   // pick the move up from where the joints are now
  arrivedAt = millis();
  Serial.println(on ? F("running") : F("stopped: send 's' to go on"));
}

void report(unsigned long now) {
  Serial.print(F("t="));
  Serial.print(now / 1000);
  Serial.print(F(" s"));
  Serial.print(F(" dist="));
  if (distanceCm) Serial.print(distanceCm);
  else Serial.print(F("clear"));
  Serial.print(F(" cm"));
  Serial.print(F(" left="));
  Serial.print(leftPwm);
  Serial.print(F(" right="));
  Serial.print(rightPwm);
  Serial.print(F(" pose="));
  Serial.print(pose + 1);
  Serial.print(moving ? F(" moving") : F(" holding"));
  Serial.println(running ? F("") : F(" stopped"));
}

void setup() {
  Serial.begin(SERIAL_BAUD);
  for (uint8_t i = 0; i < MOTOR_COUNT; i++) {
    pinMode(MOTORS[i].in1, OUTPUT);
    pinMode(MOTORS[i].in2, OUTPUT);
    pinMode(MOTORS[i].pwm, OUTPUT);
    setMotor(MOTORS[i], 0);
  }
  pinMode(TRIG_PIN, OUTPUT);
  digitalWrite(TRIG_PIN, LOW);
  pinMode(ECHO_PIN, INPUT);
  for (uint8_t b = 0; b < PCA_COUNT; b++) {
    PCA[b].begin();
    PCA[b].setOscillatorFrequency(PCA_OSC_HZ);
    PCA[b].setPWMFreq(SERVO_HZ);
  }
  // every servo goes to its home angle at once: a hobby servo has no feedback, so the first pulse is a jump
  for (uint8_t i = 0; i < JOINT_COUNT; i++) {
    jointTo[i] = JOINTS[i].home;
    writeJoint(i, JOINTS[i].home);
  }
  Serial.println(F("wall_e: wall_e.ino"));
  Serial.println(F("4 motors, PWM limit 182/255"));
  Serial.println(F("8 servos on servo_driver 0x40, 23 poses"));
  Serial.println(F("range sensor ultrasonic: Trig D11, Echo D12"));
  Serial.println(F("send 's' to stop or go on"));
}

void loop() {
  unsigned long now = millis();
  while (Serial.available()) {
    if (Serial.read() == 's') setRunning(!running);
  }
  if (!started && now >= START_DELAY_MS) {
    started = true;
    arrivedAt = now;
    Serial.println(F("start"));
  }
  if (started && running) {
    updateDrive(now);
    updateJoints(now);
  }
  if (now - lastReport >= REPORT_EVERY_MS) {
    lastReport = now;
    report(now);
  }
}
