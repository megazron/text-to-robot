// robot_hand.ino: firmware for the robot "robot_hand", generated by Text to Robot from its wiring record.
//
// What it does: runs a pose sequence, one joint at a time from home, inside the joint limits.
// Board:   Arduino Nano compatible board (ATmega328P, CH340, USB-C)
// FQBN:    arduino:avr:nano:cpu=atmega328
// Serial:  115200 baud. It reports what it is doing; send 's' to stop everything, 's' again to go on.
// Libraries: Wire, Adafruit PWM Servo Driver Library.
//
// Pin map (every line is a wire of WIRING.md that ends on the board; rewire the robot and generate again):
//   A4  i2c      I2C SDA to servo_driver   [W24 I2C_SDA]
//   A5  i2c      I2C SCL to servo_driver   [W25 I2C_SCL]
//
// Servo channels (PCA9685 outputs are wires of WIRING.md too):
//   servo_driver 0x40 channel 0  index_servo
//   servo_driver 0x40 channel 1  middle_servo
//   servo_driver 0x40 channel 2  ring_servo
//   servo_driver 0x40 channel 3  little_servo
//   servo_driver 0x40 channel 4  thumb_servo
//   servo_driver 0x40 channel 5  thumb_swing_servo (joint thumb_swing)
//
// Not driven, or to check:
//   - index_servo: no joint found for this servo, so the sketch holds it at its centre and never moves it.
//   - middle_servo: no joint found for this servo, so the sketch holds it at its centre and never moves it.
//   - ring_servo: no joint found for this servo, so the sketch holds it at its centre and never moves it.
//   - little_servo: no joint found for this servo, so the sketch holds it at its centre and never moves it.
//   - thumb_servo: no joint found for this servo, so the sketch holds it at its centre and never moves it.
//
// First run: keep clear of the joints, open the serial monitor, then switch the robot's power on.
// A joint that turns the wrong way: change its dir in JOINTS from +1 to -1. Fit each horn with the servo at its centre
// (the sketch's angle 0), the joint at the zero pose of ASSEMBLY.md. Pulse ranges are the catalog's; servo batches differ,
// so trim minUs / maxUs if a joint does not reach its end angles.

#include <Wire.h>
#include <Adafruit_PWMServoDriver.h>

const unsigned long SERIAL_BAUD = 115200;
const unsigned long START_DELAY_MS = 2000;   // quiet time after power-on before anything moves
const unsigned long REPORT_EVERY_MS = 1000;  // status line on Serial

// ---------------------------------------------------------------- servo joints
struct Joint {
  const char *name;
  uint8_t board;          // index into PCA
  uint8_t channel;        // PCA9685 channel
  uint16_t minUs, maxUs;  // pulse at the two ends of the servo's travel (catalog)
  uint16_t travel;        // that travel in degrees; the centre of it is joint angle 0
  int8_t dir;             // +1: a longer pulse turns the joint positive
  int16_t lower, upper, home;   // joint limits and home, tenths of a degree
};
const Joint JOINTS[] = {
  {"index_servo", 0, 0, 500, 2500, 180, +1, 0, 0, 0},   // index_servo: hobby_mg996r, no joint found: held at its centre
  {"middle_servo", 0, 1, 500, 2500, 180, +1, 0, 0, 0},   // middle_servo: hobby_mg996r, no joint found: held at its centre
  {"ring_servo", 0, 2, 500, 2500, 180, +1, 0, 0, 0},   // ring_servo: hobby_mg996r, no joint found: held at its centre
  {"little_servo", 0, 3, 500, 2500, 180, +1, 0, 0, 0},   // little_servo: hobby_mg996r, no joint found: held at its centre
  {"thumb_servo", 0, 4, 500, 2500, 180, +1, 0, 0, 0},   // thumb_servo: hobby_mg996r, no joint found: held at its centre
  {"thumb_swing", 0, 5, 500, 2400, 180, +1, 0, 572, 0},   // thumb_swing_servo: hobby_mg90s
};
const uint8_t JOINT_COUNT = sizeof(JOINTS) / sizeof(JOINTS[0]);
const uint16_t SERVO_HZ = 50;            // hobby servo frame rate
const uint16_t SERVO_SPEED_DPS = 60;      // the joint that moves furthest turns at this speed, the others arrive with it
const unsigned long SERVO_STEP_MS = 20;
const unsigned long HOLD_MS = 800;       // pause at each pose

// The pose sequence, tenths of a degree per joint in the order of JOINTS: home, then one joint at a time
// up to 60 % of the way to each of its limits (less where a link would meet the table) and back home.
const int16_t POSES[][6] PROGMEM = {
  {0, 0, 0, 0, 0, 0},   // home
  {0, 0, 0, 0, 0, 343},   // thumb_swing to 34.3 deg
  {0, 0, 0, 0, 0, 0},   // home
};
const uint8_t POSE_COUNT = sizeof(POSES) / sizeof(POSES[0]);

const uint32_t PCA_OSC_HZ = 25000000;    // nominal PCA9685 oscillator; clone boards are a few percent off: trim it if 50 Hz measures wrong
Adafruit_PWMServoDriver PCA[] = {Adafruit_PWMServoDriver(0x40)};   // servo_driver
const uint8_t PCA_COUNT = sizeof(PCA) / sizeof(PCA[0]);
int16_t jointNow[JOINT_COUNT], jointFrom[JOINT_COUNT], jointTo[JOINT_COUNT];
uint16_t jointUs[JOINT_COUNT];
unsigned long moveStart = 0, moveMs = 0, lastServoStep = 0, arrivedAt = 0;
uint8_t pose = 0;
bool moving = false;

bool running = true;       // 's' on Serial toggles it
bool started = false;
unsigned long lastReport = 0;

void printTenths(int16_t v) {
  if (v < 0) Serial.print('-');
  Serial.print(abs(v) / 10);
  Serial.print('.');
  Serial.print(abs(v) % 10);
}

// Pulse width for a joint angle (tenths of a degree), kept inside the joint's limits and the servo's travel.
uint16_t pulseFor(const Joint &j, int16_t angle) {
  angle = constrain(angle, j.lower, j.upper);
  long mid = ((long)j.minUs + j.maxUs) / 2;
  long us = mid + (long)j.dir * angle * (long)(j.maxUs - j.minUs) / ((long)j.travel * 10);
  return (uint16_t)constrain(us, (long)j.minUs, (long)j.maxUs);
}

void writeJoint(uint8_t i, int16_t angle) {
  jointNow[i] = angle;
  uint16_t us = pulseFor(JOINTS[i], angle);
  if (us == jointUs[i]) return;
  jointUs[i] = us;
  PCA[JOINTS[i].board].setPWM(JOINTS[i].channel, 0, (uint16_t)(((uint32_t)us * 4096UL * SERVO_HZ + 500000UL) / 1000000UL));   // 12-bit count of the 20 ms frame
}

// Start a move to a pose: every joint arrives together, the one with furthest to go at SERVO_SPEED_DPS.
void startPose(uint8_t p) {
  pose = p;
  int16_t far = 0;
  for (uint8_t i = 0; i < JOINT_COUNT; i++) {
    jointFrom[i] = jointNow[i];
    jointTo[i] = constrain((int16_t)pgm_read_word(&POSES[p][i]), JOINTS[i].lower, JOINTS[i].upper);
    far = max(far, (int16_t)abs(jointTo[i] - jointFrom[i]));
  }
  moveStart = millis();
  moveMs = (unsigned long)far * 100UL / SERVO_SPEED_DPS;
  moving = true;
  Serial.print(F("pose "));
  Serial.print(p + 1);
  Serial.print('/');
  Serial.print(POSE_COUNT);
  Serial.print(':');
  for (uint8_t i = 0; i < JOINT_COUNT; i++) {
    Serial.print(' ');
    Serial.print(JOINTS[i].name);
    Serial.print('=');
    printTenths(jointTo[i]);
  }
  Serial.println(F(" deg"));
}

void updateJoints(unsigned long now) {
  if (now - lastServoStep < SERVO_STEP_MS) return;
  lastServoStep = now;
  if (!moving) {
    if (now - arrivedAt >= HOLD_MS && POSE_COUNT > 1) startPose((pose + 1) % POSE_COUNT);
    return;
  }
  unsigned long t = now - moveStart;
  if (t >= moveMs) {
    for (uint8_t i = 0; i < JOINT_COUNT; i++) writeJoint(i, jointTo[i]);
    moving = false;
    arrivedAt = now;
    return;
  }
  for (uint8_t i = 0; i < JOINT_COUNT; i++) writeJoint(i, jointFrom[i] + (int16_t)((long)(jointTo[i] - jointFrom[i]) * (long)t / (long)moveMs));
}

// 's' on Serial: stop everything where it is, or go on.
void setRunning(bool on) {
  running = on;
  if (on && moving) startPose(pose);   // pick the move up from where the joints are now
  arrivedAt = millis();
  Serial.println(on ? F("running") : F("stopped: send 's' to go on"));
}

void report(unsigned long now) {
  Serial.print(F("t="));
  Serial.print(now / 1000);
  Serial.print(F(" s"));
  Serial.print(F(" pose="));
  Serial.print(pose + 1);
  Serial.print(moving ? F(" moving") : F(" holding"));
  Serial.println(running ? F("") : F(" stopped"));
}

void setup() {
  Serial.begin(SERIAL_BAUD);
  for (uint8_t b = 0; b < PCA_COUNT; b++) {
    PCA[b].begin();
    PCA[b].setOscillatorFrequency(PCA_OSC_HZ);
    PCA[b].setPWMFreq(SERVO_HZ);
  }
  // every servo goes to its home angle at once: a hobby servo has no feedback, so the first pulse is a jump
  for (uint8_t i = 0; i < JOINT_COUNT; i++) {
    jointTo[i] = JOINTS[i].home;
    writeJoint(i, JOINTS[i].home);
  }
  Serial.println(F("robot_hand: robot_hand.ino"));
  Serial.println(F("6 servos on servo_driver 0x40, 3 poses"));
  Serial.println(F("send 's' to stop or go on"));
}

void loop() {
  unsigned long now = millis();
  while (Serial.available()) {
    if (Serial.read() == 's') setRunning(!running);
  }
  if (!started && now >= START_DELAY_MS) {
    started = true;
    arrivedAt = now;
    Serial.println(F("start"));
  }
  if (started && running) {
    updateJoints(now);
  }
  if (now - lastReport >= REPORT_EVERY_MS) {
    lastReport = now;
    report(now);
  }
}
