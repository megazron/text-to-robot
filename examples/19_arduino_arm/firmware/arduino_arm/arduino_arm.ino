// arduino_arm.ino: firmware for the robot "arduino_arm", generated by Text to Robot from its wiring record.
//
// What it does: runs a pose sequence, one joint at a time from home, inside the joint limits.
// Board:   Arduino Uno R3 compatible board (ATmega328P, CH340 USB)
// FQBN:    arduino:avr:uno
// Serial:  115200 baud. It reports what it is doing; send 's' to stop everything, 's' again to go on.
// Libraries: Wire, Adafruit PWM Servo Driver Library.
//
// Pin map (every line is a wire of WIRING.md that ends on the board; rewire the robot and generate again):
//   A4  i2c      I2C SDA to servo_driver   [W18 I2C_SDA]
//   A5  i2c      I2C SCL to servo_driver   [W19 I2C_SCL]
//
// Servo channels (PCA9685 outputs are wires of WIRING.md too):
//   servo_driver 0x40 channel 0  yaw_servo (joint yaw)
//   servo_driver 0x40 channel 1  shoulder_servo (joint shoulder)
//   servo_driver 0x40 channel 2  elbow_servo (joint elbow)
//   servo_driver 0x40 channel 3  claw_servo (joint claw)
//
// Not driven, or to check:
//   - elbow: the robot allows -120 to 120 deg but the TowerPro MG996R standard servo turns 180 deg (-90 to 90 about its centre): the sketch stays inside -90 to 90 deg.
//   - shoulder: the pose sequence turns it to 62.2 deg, not 67.8: further and a link would go under the surface the robot stands on.
//
// First run: keep clear of the joints, open the serial monitor, then switch the robot's power on.
// A joint that turns the wrong way: change its dir in JOINTS from +1 to -1. Fit each horn with the servo at its centre
// (the sketch's angle 0), the joint at the zero pose of ASSEMBLY.md. Pulse ranges are the catalog's; servo batches differ,
// so trim minUs / maxUs if a joint does not reach its end angles.

#include <Wire.h>
#include <Adafruit_PWMServoDriver.h>

const unsigned long SERIAL_BAUD = 115200;
const unsigned long START_DELAY_MS = 2000;   // quiet time after power-on before anything moves
const unsigned long REPORT_EVERY_MS = 1000;  // status line on Serial

// ---------------------------------------------------------------- servo joints
struct Joint {
  const char *name;
  uint8_t board;          // index into PCA
  uint8_t channel;        // PCA9685 channel
  uint16_t minUs, maxUs;  // pulse at the two ends of the servo's travel (catalog)
  uint16_t travel;        // that travel in degrees; the centre of it is joint angle 0
  int8_t dir;             // +1: a longer pulse turns the joint positive
  int16_t lower, upper, home;   // joint limits and home, tenths of a degree
};
const Joint JOINTS[] = {
  {"yaw", 0, 0, 500, 2400, 180, +1, -900, 900, 0},   // yaw_servo: hobby_sg90
  {"shoulder", 0, 1, 500, 2500, 180, +1, -900, 900, 344},   // shoulder_servo: hobby_mg996r
  {"elbow", 0, 2, 500, 2500, 180, +1, -900, 900, 688},   // elbow_servo: hobby_mg996r
  {"claw", 0, 3, 500, 2400, 180, +1, 0, 166, 0},   // claw_servo: hobby_sg90
};
const uint8_t JOINT_COUNT = sizeof(JOINTS) / sizeof(JOINTS[0]);
const uint16_t SERVO_HZ = 50;            // hobby servo frame rate
const uint16_t SERVO_SPEED_DPS = 60;      // the joint that moves furthest turns at this speed, the others arrive with it
const unsigned long SERVO_STEP_MS = 20;
const unsigned long HOLD_MS = 800;       // pause at each pose

// The pose sequence, tenths of a degree per joint in the order of JOINTS: home, then one joint at a time
// up to 60 % of the way to each of its limits (less where a link would meet the table) and back home.
const int16_t POSES[][4] PROGMEM = {
  {0, 344, 688, 0},   // home
  {540, 344, 688, 0},   // yaw to 54 deg
  {-540, 344, 688, 0},   // yaw to -54 deg
  {0, 344, 688, 0},   // home
  {0, 622, 688, 0},   // shoulder to 62.2 deg
  {0, -402, 688, 0},   // shoulder to -40.2 deg
  {0, 344, 688, 0},   // home
  {0, 344, 815, 0},   // elbow to 81.5 deg
  {0, 344, -265, 0},   // elbow to -26.5 deg
  {0, 344, 688, 0},   // home
  {0, 344, 688, 100},   // claw to 10 deg
  {0, 344, 688, 0},   // home
};
const uint8_t POSE_COUNT = sizeof(POSES) / sizeof(POSES[0]);

const uint32_t PCA_OSC_HZ = 25000000;    // nominal PCA9685 oscillator; clone boards are a few percent off: trim it if 50 Hz measures wrong
Adafruit_PWMServoDriver PCA[] = {Adafruit_PWMServoDriver(0x40)};   // servo_driver
const uint8_t PCA_COUNT = sizeof(PCA) / sizeof(PCA[0]);
int16_t jointNow[JOINT_COUNT], jointFrom[JOINT_COUNT], jointTo[JOINT_COUNT];
uint16_t jointUs[JOINT_COUNT];
unsigned long moveStart = 0, moveMs = 0, lastServoStep = 0, arrivedAt = 0;
uint8_t pose = 0;
bool moving = false;

bool running = true;       // 's' on Serial toggles it
bool started = false;
unsigned long lastReport = 0;

void printTenths(int16_t v) {
  if (v < 0) Serial.print('-');
  Serial.print(abs(v) / 10);
  Serial.print('.');
  Serial.print(abs(v) % 10);
}

// Pulse width for a joint angle (tenths of a degree), kept inside the joint's limits and the servo's travel.
uint16_t pulseFor(const Joint &j, int16_t angle) {
  angle = constrain(angle, j.lower, j.upper);
  long mid = ((long)j.minUs + j.maxUs) / 2;
  long us = mid + (long)j.dir * angle * (long)(j.maxUs - j.minUs) / ((long)j.travel * 10);
  return (uint16_t)constrain(us, (long)j.minUs, (long)j.maxUs);
}

void writeJoint(uint8_t i, int16_t angle) {
  jointNow[i] = angle;
  uint16_t us = pulseFor(JOINTS[i], angle);
  if (us == jointUs[i]) return;
  jointUs[i] = us;
  PCA[JOINTS[i].board].setPWM(JOINTS[i].channel, 0, (uint16_t)(((uint32_t)us * 4096UL * SERVO_HZ + 500000UL) / 1000000UL));   // 12-bit count of the 20 ms frame
}

// Start a move to a pose: every joint arrives together, the one with furthest to go at SERVO_SPEED_DPS.
void startPose(uint8_t p) {
  pose = p;
  int16_t far = 0;
  for (uint8_t i = 0; i < JOINT_COUNT; i++) {
    jointFrom[i] = jointNow[i];
    jointTo[i] = constrain((int16_t)pgm_read_word(&POSES[p][i]), JOINTS[i].lower, JOINTS[i].upper);
    far = max(far, (int16_t)abs(jointTo[i] - jointFrom[i]));
  }
  moveStart = millis();
  moveMs = (unsigned long)far * 100UL / SERVO_SPEED_DPS;
  moving = true;
  Serial.print(F("pose "));
  Serial.print(p + 1);
  Serial.print('/');
  Serial.print(POSE_COUNT);
  Serial.print(':');
  for (uint8_t i = 0; i < JOINT_COUNT; i++) {
    Serial.print(' ');
    Serial.print(JOINTS[i].name);
    Serial.print('=');
    printTenths(jointTo[i]);
  }
  Serial.println(F(" deg"));
}

void updateJoints(unsigned long now) {
  if (now - lastServoStep < SERVO_STEP_MS) return;
  lastServoStep = now;
  if (!moving) {
    if (now - arrivedAt >= HOLD_MS && POSE_COUNT > 1) startPose((pose + 1) % POSE_COUNT);
    return;
  }
  unsigned long t = now - moveStart;
  if (t >= moveMs) {
    for (uint8_t i = 0; i < JOINT_COUNT; i++) writeJoint(i, jointTo[i]);
    moving = false;
    arrivedAt = now;
    return;
  }
  for (uint8_t i = 0; i < JOINT_COUNT; i++) writeJoint(i, jointFrom[i] + (int16_t)((long)(jointTo[i] - jointFrom[i]) * (long)t / (long)moveMs));
}

// 's' on Serial: stop everything where it is, or go on.
void setRunning(bool on) {
  running = on;
  if (on && moving) startPose(pose);   // pick the move up from where the joints are now
  arrivedAt = millis();
  Serial.println(on ? F("running") : F("stopped: send 's' to go on"));
}

void report(unsigned long now) {
  Serial.print(F("t="));
  Serial.print(now / 1000);
  Serial.print(F(" s"));
  Serial.print(F(" pose="));
  Serial.print(pose + 1);
  Serial.print(moving ? F(" moving") : F(" holding"));
  Serial.println(running ? F("") : F(" stopped"));
}

void setup() {
  Serial.begin(SERIAL_BAUD);
  for (uint8_t b = 0; b < PCA_COUNT; b++) {
    PCA[b].begin();
    PCA[b].setOscillatorFrequency(PCA_OSC_HZ);
    PCA[b].setPWMFreq(SERVO_HZ);
  }
  // every servo goes to its home angle at once: a hobby servo has no feedback, so the first pulse is a jump
  for (uint8_t i = 0; i < JOINT_COUNT; i++) {
    jointTo[i] = JOINTS[i].home;
    writeJoint(i, JOINTS[i].home);
  }
  Serial.println(F("arduino_arm: arduino_arm.ino"));
  Serial.println(F("4 servos on servo_driver 0x40, 12 poses"));
  Serial.println(F("send 's' to stop or go on"));
}

void loop() {
  unsigned long now = millis();
  while (Serial.available()) {
    if (Serial.read() == 's') setRunning(!running);
  }
  if (!started && now >= START_DELAY_MS) {
    started = true;
    arrivedAt = now;
    Serial.println(F("start"));
  }
  if (started && running) {
    updateJoints(now);
  }
  if (now - lastReport >= REPORT_EVERY_MS) {
    lastReport = now;
    report(now);
  }
}
